/*
 * Allwinner Technology CO., Ltd.
 */

/dts-v1/;

#include "sun55i-t527-longanpi-4b.dtsi"

/{
	model = "LonganPi 4B(PCIE Mode)";
	board = "T527", "T527-LM4B";
	compatible = "allwinner,t527", "arm,sun55iw3p1", "Sipeed,T527-LM4B";
};

&combophy {
	resets = <&ccu RST_BUS_PCIE_USB3>;
	phy_use_sel = <0>; /* 0:PCIE; 1:USB3; 2:PCIE_USB3_U2 */
	status = "okay";
};

&pcie {
	reset-gpios = <&pio PH 11 GPIO_ACTIVE_HIGH>;
	wake-gpios = <&pio PH 12 GPIO_ACTIVE_HIGH>;
	pcie3v3-supply = <&reg_bldo1>;
	pcie1v8-supply = <&reg_cldo1>;
	clk-freq-100M;
	status = "okay";
};